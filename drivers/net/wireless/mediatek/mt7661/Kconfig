## drivers/net/wireless/mediatek/mt7661/Kconfig
```kconfig
menu "Mediatek MT7661S (SDIO) support"

config MT7661_COMBO_CHIP
	string "MTK COMBO CHIP"
	default "MT7663"
        help
          This is MT7663S without CR4 chip integrated.
	
config MT7661_WIFI_ONLY
	tristate "MTK WIFI ONLY"
	default m

endmenu
```

## drivers/net/wireless/realtek/mediatek/mt7668/Kconfig
```kconfig
menu "Mediatek MT7668S (SDIO) support"

config MTK_COMBO_CHIP
	string "MTK COMBO CHIP"
	default "MT7668"

config MTK_WIFI_ONLY
	tristate "MTK WIFI ONLY"
	default m

endmenu
```
